/*
 * Copyright (c) 2026, Chao Liu <chao.liu.zevorn@gmail.com>
 * SPDX-License-Identifier: MIT
 *
 * SSD1306 OLED driver — 128x64 monochrome, I2C, no LVGL.
 * Uses ESP-IDF's esp_lcd SSD1306 panel driver for low-level
 * commands and a 1KB local framebuffer for drawing.
 */

#include "drivers/display/espressif/ssd1306_oled.h"

#ifdef CLAW_PLATFORM_ESP_IDF

#include "esp_lcd_panel_ops.h"
#include "esp_lcd_panel_ssd1306.h"
#include "esp_lcd_panel_io.h"
#include "driver/i2c_master.h"
#include "esp_log.h"

#include <string.h>

#define TAG "ssd1306"

#define I2C_ADDR    0x3C
#define I2C_FREQ_HZ 400000

/* 8x8 ASCII font (chars 32-126, 95 glyphs, 760 bytes) */
static const uint8_t font8x8[][8] = {
    {0x00,0x00,0x00,0x00,0x00,0x00,0x00,0x00}, /* ' ' */
    {0x18,0x3C,0x3C,0x18,0x18,0x00,0x18,0x00}, /* '!' */
    {0x36,0x36,0x00,0x00,0x00,0x00,0x00,0x00}, /* '"' */
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    {0x6E,0x3B,0x00,0x00,0x00,0x00,0x00,0x00}, /* '~' */
};

static esp_lcd_panel_handle_t s_panel;
static esp_lcd_panel_io_handle_t s_panel_io;
static uint8_t s_fb[SSD1306_WIDTH * SSD1306_PAGES];
static int s_initialized;

static int ssd1306_init_panel(i2c_master_bus_handle_t bus)
{
    esp_err_t err;

    /* Panel IO (I2C) */
    esp_lcd_panel_io_i2c_config_t io_cfg = {
        .dev_addr = I2C_ADDR,
        .control_phase_bytes = 1,
        .dc_bit_offset = 6,
        .lcd_cmd_bits = 8,
        .lcd_param_bits = 8,
        .scl_speed_hz = I2C_FREQ_HZ,
    };
    err = esp_lcd_new_panel_io_i2c_v2(bus, &io_cfg, &s_panel_io);
    if (err != ESP_OK) {
        ESP_LOGE(TAG, "panel IO init: %s", esp_err_to_name(err));
        return -1;
    }

    /* SSD1306 panel */
    esp_lcd_panel_dev_config_t panel_cfg = {
        .reset_gpio_num = -1,
        .bits_per_pixel = 1,
    };
    esp_lcd_panel_ssd1306_config_t ssd_cfg = {
        .height = SSD1306_HEIGHT,
    };
    panel_cfg.vendor_config = &ssd_cfg;

    err = esp_lcd_new_panel_ssd1306(s_panel_io, &panel_cfg, &s_panel);
    if (err != ESP_OK) {
        ESP_LOGE(TAG, "panel init: %s", esp_err_to_name(err));
        return -1;
    }

    esp_lcd_panel_reset(s_panel);
    esp_lcd_panel_init(s_panel);
    esp_lcd_panel_disp_on_off(s_panel, true);
    esp_lcd_panel_mirror(s_panel, true, true);

    memset(s_fb, 0, sizeof(s_fb));
    ssd1306_flush();

    s_initialized = 1;
    ESP_LOGI(TAG, "128x64 OLED ready (I2C 0x%02X)", I2C_ADDR);
    return 0;
}

int ssd1306_init(int sda_pin, int scl_pin)
{
    i2c_master_bus_config_t bus_cfg = {
        .i2c_port = I2C_NUM_0,
        .sda_io_num = sda_pin,
        .scl_io_num = scl_pin,
        .clk_source = I2C_CLK_SRC_DEFAULT,
        .glitch_ignore_cnt = 7,
        .flags.enable_internal_pullup = 1,
    };
    i2c_master_bus_handle_t bus;
    esp_err_t err = i2c_new_master_bus(&bus_cfg, &bus);
    if (err != ESP_OK) {
        ESP_LOGE(TAG, "I2C bus init: %s", esp_err_to_name(err));
        return -1;
    }
    return ssd1306_init_panel(bus);
}

int ssd1306_init_on_bus(void *bus)
{
    return ssd1306_init_panel((i2c_master_bus_handle_t)bus);
}

void ssd1306_clear(void)
{
    if (!s_initialized) {
        return;
    }
    memset(s_fb, 0, sizeof(s_fb));
}

void ssd1306_flush(void)
{
    if (!s_initialized) {
        return;
    }
    esp_lcd_panel_draw_bitmap(s_panel, 0, 0,
                              SSD1306_WIDTH, SSD1306_HEIGHT,
                              s_fb);
}

void ssd1306_set_pixel(int x, int y, int on)
{
    if (x < 0 || x >= SSD1306_WIDTH || y < 0 || y >= SSD1306_HEIGHT) {
        return;
    }
    int page = y / 8;
    int bit = y % 8;
    int idx = page * SSD1306_WIDTH + x;

    if (on) {
        s_fb[idx] |= (1 << bit);
    } else {
        s_fb[idx] &= ~(1 << bit);
    }
}

static void draw_char(int x, int y, char ch)
{
    if (ch < 32 || ch > 126) {
        ch = ' ';
    }
    const uint8_t *glyph = font8x8[ch - 32];

    for (int row = 0; row < 8; row++) {
        uint8_t line = glyph[row];
        for (int col = 0; col < 8; col++) {
            ssd1306_set_pixel(x + col, y + row, (line >> col) & 1);
        }
    }
}

void ssd1306_write_line(int row, const char *text)
{
    if (!s_initialized || !text || row < 0 || row >= SSD1306_PAGES) {
        return;
    }

    /* Clear row */
    memset(&s_fb[row * SSD1306_WIDTH], 0, SSD1306_WIDTH);

    int x = 0;
    int max_chars = SSD1306_WIDTH / 8;
    for (int i = 0; text[i] && i < max_chars; i++) {
        draw_char(x, row * 8, text[i]);
        x += 8;
    }
    ssd1306_flush();
}

void ssd1306_progress_bar(int row, int percent)
{
    if (!s_initialized || row < 0 || row >= SSD1306_PAGES) {
        return;
    }

    if (percent < 0) {
        percent = 0;
    }
    if (percent > 100) {
        percent = 100;
    }

    /* Clear row */
    memset(&s_fb[row * SSD1306_WIDTH], 0, SSD1306_WIDTH);

    int bar_width = (SSD1306_WIDTH - 4) * percent / 100;

    /* Border: top and bottom lines */
    for (int x = 0; x < SSD1306_WIDTH; x++) {
        ssd1306_set_pixel(x, row * 8, 1);
        ssd1306_set_pixel(x, row * 8 + 7, 1);
    }
    /* Border: left and right */
    for (int y = 0; y < 8; y++) {
        ssd1306_set_pixel(0, row * 8 + y, 1);
        ssd1306_set_pixel(SSD1306_WIDTH - 1, row * 8 + y, 1);
    }
    /* Fill */
    for (int x = 2; x < 2 + bar_width; x++) {
        for (int y = 2; y < 6; y++) {
            ssd1306_set_pixel(x, row * 8 + y, 1);
        }
    }

    ssd1306_flush();
}

#else /* non-ESP-IDF */

int  ssd1306_init(int sda_pin, int scl_pin) { (void)sda_pin; (void)scl_pin; return -1; }
void ssd1306_clear(void) {}
void ssd1306_flush(void) {}
void ssd1306_write_line(int row, const char *text) { (void)row; (void)text; }
void ssd1306_progress_bar(int row, int percent) { (void)row; (void)percent; }
void ssd1306_set_pixel(int x, int y, int on) { (void)x; (void)y; (void)on; }

#endif

/* OOP driver registration */
#include "claw/core/claw_driver.h"

static claw_err_t ssd1306_drv_probe(struct claw_driver *drv)
{
    (void)drv;
    /* Actual init requires pin config, deferred to platform board_init */
    return CLAW_OK;
}

static const struct claw_driver_ops ssd1306_drv_ops = {
    .probe  = ssd1306_drv_probe,
    .remove = NULL,
};

static struct claw_driver ssd1306_drv = {
    .name  = "ssd1306_oled",
    .ops   = &ssd1306_drv_ops,
    .state = CLAW_DRV_REGISTERED,
};

CLAW_DRIVER_REGISTER(ssd1306_oled, &ssd1306_drv);
