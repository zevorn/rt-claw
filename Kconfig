## Kconfig
```kconfig
mainmenu "RT-Claw Project Configuration"

BSP_DIR := .

RTT_DIR := vendor/rt-thread

PKGS_DIR := packages

source "$(RTT_DIR)/Kconfig"
osource "$PKGS_DIR/Kconfig"
source "$(BSP_DIR)/drivers/Kconfig"
```

## platform/atk-esp32s3-lvgl/components/rt_claw/Kconfig
```kconfig
menu "rt-claw Configuration"

    # AI Engine credentials and tuning are configured at the top level
    # via Meson options or environment variables.  See claw_config.h.
    menu "Board Config"
        menu "Audio Config"

            config RTCLAW_ES8311
                bool "Default Audio Set"
                default n
                help
                    Configure Audio Driver. 
            config RTCLAW_ES8388
                bool "Enable ES8388 Audio Codec"
                default n
                help
                    Configure Audio Driver. 
        endmenu

        menu "Display Config"
            config RTCLAW_SSD1306
                bool "Default Display Set"
                default n
                help
                    Configure Display Module. 

            config RTCLAW_USE_LVGL
                bool "Uses the LVGL interface"
                default n
                help
                    Uses the LVGL interface. 

        endmenu
    endmenu

    menu "WiFi"

        config RTCLAW_WIFI_SSID
            string "Default WiFi SSID"
            default ""
            help
                Build-time WiFi SSID. Can be overridden at runtime
                via /wifi_set shell command (saved to NVS).

        config RTCLAW_WIFI_PASS
            string "Default WiFi password"
            default ""
            help
                Build-time WiFi password. Can be overridden at runtime
                via /wifi_set shell command (saved to NVS).

        config RTCLAW_WIFI_PROVISION_ENABLE
            bool "Enable WiFi provisioning (AP + Web portal)"
            default y
            help
                Start a SoftAP hotspot with captive portal when no WiFi
                credentials are configured or STA connection fails.
                Users can configure WiFi and API keys via a web page.

    endmenu

    menu "Module Selection"

        config RTCLAW_AI_BOOT_TEST
            bool "Run AI connection test at boot"
            default y
            help
                Send a test message to the LLM API during startup
                to verify connectivity.  Disable on real hardware
                to save time and bandwidth.

        config RTCLAW_SHELL_ENABLE
            bool "Enable interactive UART shell"
            default y
            help
                Chat-first UART shell. Direct input goes to AI,
                /commands for system. Disable to save RAM when
                using only IM channels (e.g. Feishu).
        
        config RTCLAW_AUDIO_ENABLE
            bool "Enable audio (ES8388 codec + PA)"
            default n
            help
                ES8388 audio codec and power amplifier.
                Disable to skip audio init and save resources.

        config RTCLAW_LCD_ENABLE
            bool "Enable LCD display"
            default n
            help
                SPI LCD panel support.
                Disable if no display hardware is present.

        config RTCLAW_SWARM_ENABLE
            bool "Enable swarm intelligence"
            default y
            help
                Node discovery, heartbeat, and distributed task
                scheduling over UDP broadcast.

        config RTCLAW_SCHED_ENABLE
            bool "Enable task scheduler"
            default y
            help
                Timer-driven task execution engine.

        config RTCLAW_SKILL_ENABLE
            bool "Enable skill system"
            default y
            help
                Predefined prompt templates (draw, monitor, greet).

        config RTCLAW_FEISHU_ENABLE
            bool "Enable Feishu (Lark) IM integration"
            default n
            help
                WebSocket long connection to Feishu. Receives messages
                and replies via AI engine. No public IP needed.

        config RTCLAW_TELEGRAM_ENABLE
            bool "Enable Telegram Bot integration"
            default n
            help
                HTTP long-polling Telegram Bot. Receives messages and
                replies via AI engine. No public IP needed.

        config RTCLAW_HEARTBEAT_ENABLE
            bool "Enable periodic AI heartbeat"
            default n
            depends on RTCLAW_SCHED_ENABLE
            help
                Periodic LLM health check with device status reporting.

        config RTCLAW_OTA_ENABLE
            bool "Enable OTA firmware update"
            default n
            help
                Over-the-air firmware update via HTTP(S).
                Requires OTA partition table (ota_0 + ota_1).

        config RTCLAW_USB_HID_MOUSE
            bool "Enable USB HID mouse"
            default n
            depends on IDF_TARGET_ESP32S3
            help
                Emulate a USB mouse via ESP32-S3 USB OTG (GPIO 19/20).
                Uses TinyUSB HID device class.
                Note: enabling this makes the USB OTG port a HID
                device — USB Serial/JTAG console must use UART instead.

        menu "Tool Use"

            config RTCLAW_TOOL_GPIO
                bool "GPIO tools"
                default y
                help
                    gpio_set, gpio_get, gpio_config tools.

            config RTCLAW_TOOL_SYSTEM
                bool "System info tools"
                default y
                help
                    system_info, memory_info, system_restart tools.

            config RTCLAW_TOOL_LCD
                bool "LCD drawing tools"
                default n
                depends on RTCLAW_LCD_ENABLE
                help
                    lcd_fill, lcd_text, lcd_rect, lcd_line, lcd_circle tools.

            config RTCLAW_TOOL_SCHED
                bool "Scheduler tools"
                default y
                depends on RTCLAW_SCHED_ENABLE
                help
                    schedule_task, remove_task tools.

            config RTCLAW_TOOL_NET
                bool "Network (HTTP) tools"
                default y
                help
                    http_request tool for GET/POST requests.

            config RTCLAW_TOOL_MOUSE
                bool "USB HID mouse tools"
                default y
                depends on RTCLAW_USB_HID_MOUSE
                help
                    mouse_move, mouse_click, mouse_scroll tools.

        endmenu

    endmenu

endmenu
```

## platform/esp32c3/boards/devkit/sdkconfig.defaults
```kconfig
# rt-claw ESP32-C3 real hardware — devkit-c3 (generic 4MB, DIO)

# ---- Target: ESP32-C3 ----
CONFIG_IDF_TARGET="esp32c3"

# ---- Flash: 4MB DIO ----
CONFIG_ESPTOOLPY_FLASHSIZE_4MB=y
CONFIG_ESPTOOLPY_FLASHMODE_DIO=y

# ---- CPU: 160MHz ----
CONFIG_ESP_DEFAULT_CPU_FREQ_MHZ_160=y

# ---- Ethernet: disabled (WiFi only) ----
# CONFIG_ETH_USE_SPI_ETHERNET is not set

# ---- WiFi ----
CONFIG_ESP_WIFI_STATIC_RX_BUFFER_NUM=3
CONFIG_ESP_WIFI_DYNAMIC_RX_BUFFER_NUM=6
CONFIG_ESP_WIFI_RX_BA_WIN=3
CONFIG_LWIP_TCPIP_RECVMBOX_SIZE=16
CONFIG_LWIP_LOCAL_HOSTNAME="rt-claw"

# ---- TLS: internal RAM allocation (no PSRAM) ----
CONFIG_MBEDTLS_DYNAMIC_FREE_CONFIG_DATA=y
CONFIG_MBEDTLS_SSL_IN_CONTENT_LEN=8192
CONFIG_MBEDTLS_SSL_OUT_CONTENT_LEN=4096
CONFIG_MBEDTLS_CERTIFICATE_BUNDLE=y
CONFIG_MBEDTLS_CERTIFICATE_BUNDLE_DEFAULT_FULL=y
CONFIG_MBEDTLS_SSL_PROTO_TLS1_3=y

# ---- Partition table ----
CONFIG_PARTITION_TABLE_CUSTOM=y
CONFIG_PARTITION_TABLE_CUSTOM_FILENAME="boards/devkit/partitions.csv"

# ---- Console: UART ----
CONFIG_ESP_CONSOLE_UART_DEFAULT=y
CONFIG_ESP_CONSOLE_UART_BAUDRATE=115200

# ---- FreeRTOS ----
CONFIG_FREERTOS_HZ=1000
CONFIG_FREERTOS_TIMER_TASK_STACK_DEPTH=4096
CONFIG_ESP_SYSTEM_EVENT_TASK_STACK_SIZE=4096
CONFIG_ESP_MAIN_TASK_STACK_SIZE=16384

# ---- Compiler ----
CONFIG_COMPILER_OPTIMIZATION_SIZE=y
CONFIG_NEWLIB_STDIN_LINE_ENDING_LF=y

# ---- rt-claw modules ----
CONFIG_RTCLAW_SHELL_ENABLE=y
CONFIG_RTCLAW_SWARM_ENABLE=y
CONFIG_RTCLAW_SCHED_ENABLE=y
CONFIG_RTCLAW_SKILL_ENABLE=y
CONFIG_RTCLAW_TOOL_GPIO=y
CONFIG_RTCLAW_TOOL_SYSTEM=y
CONFIG_RTCLAW_TOOL_SCHED=y
CONFIG_RTCLAW_TOOL_NET=y

# ---- IM integrations ----
# CONFIG_RTCLAW_FEISHU_ENABLE is not set
# CONFIG_RTCLAW_TELEGRAM_ENABLE is not set

# AI Engine credentials and tuning: see claw_config.h + meson options
```

## platform/esp32c3/boards/qemu/sdkconfig.defaults
```kconfig
# rt-claw ESP32-C3 SDK configuration defaults (QEMU board)

# FreeRTOS
CONFIG_FREERTOS_HZ=1000
CONFIG_FREERTOS_TIMER_TASK_STACK_DEPTH=4096

# System
CONFIG_ESP_SYSTEM_EVENT_TASK_STACK_SIZE=4096

# WiFi disabled (QEMU uses OpenCores Ethernet)
# CONFIG_ESP_WIFI_ENABLED=y

# Ethernet — OpenCores MAC for QEMU
CONFIG_ETH_ENABLED=y
CONFIG_ETH_USE_OPENETH=y

# LWIP
CONFIG_LWIP_DNS_SUPPORT_MDNS_QUERIES=n

# Console / UART
CONFIG_ESP_CONSOLE_UART_DEFAULT=y
CONFIG_ESP_CONSOLE_UART_BAUDRATE=115200

# Flash
CONFIG_ESPTOOLPY_FLASHSIZE_4MB=y
CONFIG_ESPTOOLPY_FLASHSIZE="4MB"

# Partition table
CONFIG_PARTITION_TABLE_CUSTOM=y
CONFIG_PARTITION_TABLE_CUSTOM_FILENAME="boards/qemu/partitions.csv"

# TLS / Certificate bundle (for HTTPS API calls)
CONFIG_MBEDTLS_CERTIFICATE_BUNDLE=y
CONFIG_MBEDTLS_CERTIFICATE_BUNDLE_DEFAULT_FULL=y
CONFIG_MBEDTLS_SSL_PROTO_TLS1_3=y

# Main task needs more stack for TLS + JSON parsing
CONFIG_ESP_MAIN_TASK_STACK_SIZE=16384

# QEMU chip revision (efuse reports v0.0)
CONFIG_ESP32C3_REV_MIN_0=y

# Optimization
CONFIG_COMPILER_OPTIMIZATION_SIZE=y

# Newlib
CONFIG_NEWLIB_STDIN_LINE_ENDING_LF=y

# Feishu (Lark) Integration
# CONFIG_RTCLAW_FEISHU_ENABLE=y
```

## platform/esp32c3/boards/qemu/sdkconfig.defaults.feishu
```kconfig
# rt-claw Feishu Bot — headless IM bot with full AI agent
#
# Usage:
#   cp sdkconfig.defaults.feishu sdkconfig.defaults
#   rm -f sdkconfig
#   idf.py set-target esp32c3
#   idf.py menuconfig   # set API key, Feishu App ID & Secret
#   idf.py build
#
# Enables: Feishu, tools (no LCD), skills, scheduler, swarm
# Disables: Shell (saves ~4KB RAM), LCD (headless mode)

# ---- Base platform ----
CONFIG_FREERTOS_HZ=1000
CONFIG_FREERTOS_TIMER_TASK_STACK_DEPTH=4096
CONFIG_ESP_SYSTEM_EVENT_TASK_STACK_SIZE=4096
CONFIG_ETH_ENABLED=y
CONFIG_ETH_USE_OPENETH=y
CONFIG_LWIP_DNS_SUPPORT_MDNS_QUERIES=n
CONFIG_ESP_CONSOLE_UART_DEFAULT=y
CONFIG_ESP_CONSOLE_UART_BAUDRATE=115200
CONFIG_ESPTOOLPY_FLASHSIZE_4MB=y
CONFIG_ESPTOOLPY_FLASHSIZE="4MB"
CONFIG_PARTITION_TABLE_CUSTOM=y
CONFIG_PARTITION_TABLE_CUSTOM_FILENAME="boards/qemu/partitions.csv"
CONFIG_MBEDTLS_CERTIFICATE_BUNDLE=y
CONFIG_MBEDTLS_CERTIFICATE_BUNDLE_DEFAULT_FULL=y
CONFIG_MBEDTLS_SSL_PROTO_TLS1_3=y
CONFIG_ESP_MAIN_TASK_STACK_SIZE=16384
CONFIG_ESP32C3_REV_MIN_0=y
CONFIG_COMPILER_OPTIMIZATION_SIZE=y
CONFIG_NEWLIB_STDIN_LINE_ENDING_LF=y

# ---- QEMU workaround: disable HW SHA (QEMU SHA DMA bug) ----
# CONFIG_MBEDTLS_HARDWARE_SHA is not set

# ---- rt-claw modules ----
# CONFIG_RTCLAW_SHELL_ENABLE is not set
# CONFIG_RTCLAW_LCD_ENABLE is not set
CONFIG_RTCLAW_SWARM_ENABLE=y
CONFIG_RTCLAW_SCHED_ENABLE=y
CONFIG_RTCLAW_SKILL_ENABLE=y
CONFIG_RTCLAW_TOOL_GPIO=y
CONFIG_RTCLAW_TOOL_SYSTEM=y
# CONFIG_RTCLAW_TOOL_LCD is not set
CONFIG_RTCLAW_TOOL_SCHED=y
CONFIG_RTCLAW_TOOL_NET=y

# ---- Feishu IM ----
CONFIG_RTCLAW_FEISHU_ENABLE=y
# Set App ID and Secret via: idf.py menuconfig -> rt-claw -> Feishu

# ---- Telegram Bot ----
# CONFIG_RTCLAW_TELEGRAM_ENABLE is not set
```

## platform/esp32c3/boards/xiaozhi-xmini/sdkconfig.defaults
```kconfig
# rt-claw ESP32-C3 real hardware — xiaozhi (16MB flash, DIO)

# ---- Target: ESP32-C3 ----
CONFIG_IDF_TARGET="esp32c3"

# ---- Flash: 16MB DIO ----
CONFIG_ESPTOOLPY_FLASHSIZE_16MB=y
CONFIG_ESPTOOLPY_FLASHMODE_DIO=y

# ---- CPU: 160MHz ----
CONFIG_ESP_DEFAULT_CPU_FREQ_MHZ_160=y

# ---- Ethernet: disabled (WiFi only) ----
# CONFIG_ETH_USE_SPI_ETHERNET is not set

# ---- WiFi: memory-optimized (from xiaozhi-esp32) ----
CONFIG_ESP_WIFI_STATIC_RX_BUFFER_NUM=3
CONFIG_ESP_WIFI_DYNAMIC_RX_BUFFER_NUM=6
CONFIG_ESP_WIFI_RX_BA_WIN=3
CONFIG_ESP_WIFI_IRAM_OPT=n
CONFIG_ESP_WIFI_RX_IRAM_OPT=n
CONFIG_ESP_WIFI_DYNAMIC_RX_MGMT_BUFFER=y
CONFIG_ESP_WIFI_ENABLE_WPA3_SAE=n
CONFIG_ESP_WIFI_ESPNOW_MAX_ENCRYPT_NUM=0
CONFIG_LWIP_TCPIP_RECVMBOX_SIZE=16
CONFIG_LWIP_LOCAL_HOSTNAME="rt-claw"
CONFIG_LWIP_IPV6=n

# ---- TLS: match xiaozhi-esp32 proven config ----
CONFIG_MBEDTLS_DYNAMIC_BUFFER=y
CONFIG_MBEDTLS_DYNAMIC_FREE_CONFIG_DATA=y
CONFIG_MBEDTLS_SSL_KEEP_PEER_CERTIFICATE=n
CONFIG_MBEDTLS_CERTIFICATE_BUNDLE=y
CONFIG_MBEDTLS_CERTIFICATE_BUNDLE_DEFAULT_FULL=y

# ---- Partition table ----
CONFIG_PARTITION_TABLE_CUSTOM=y
CONFIG_PARTITION_TABLE_CUSTOM_FILENAME="boards/xiaozhi-xmini/partitions.csv"

# ---- Console: USB Serial JTAG (xmini-c3 uses USB-JTAG CDC) ----
CONFIG_ESP_CONSOLE_USB_SERIAL_JTAG=y

# ---- FreeRTOS ----
CONFIG_FREERTOS_HZ=1000
CONFIG_FREERTOS_TIMER_TASK_STACK_DEPTH=4096
CONFIG_ESP_SYSTEM_EVENT_TASK_STACK_SIZE=4096
CONFIG_ESP_MAIN_TASK_STACK_SIZE=16384

# ---- Compiler ----
CONFIG_COMPILER_OPTIMIZATION_SIZE=y
CONFIG_NEWLIB_STDIN_LINE_ENDING_LF=y

# ---- rt-claw modules ----
# CONFIG_RTCLAW_AI_BOOT_TEST is not set
CONFIG_RTCLAW_SHELL_ENABLE=y
CONFIG_RTCLAW_SWARM_ENABLE=y
CONFIG_RTCLAW_SCHED_ENABLE=y
CONFIG_RTCLAW_SKILL_ENABLE=y
CONFIG_RTCLAW_TOOL_GPIO=y
CONFIG_RTCLAW_TOOL_SYSTEM=y
CONFIG_RTCLAW_TOOL_SCHED=y
CONFIG_RTCLAW_TOOL_NET=y

# ---- IM integrations ----
# CONFIG_RTCLAW_FEISHU_ENABLE is not set
# CONFIG_RTCLAW_TELEGRAM_ENABLE is not set

# ---- OTA ----
CONFIG_RTCLAW_OTA_ENABLE=y
CONFIG_BOOTLOADER_APP_ROLLBACK_ENABLE=y

# AI Engine credentials and tuning: see claw_config.h + meson options
```
