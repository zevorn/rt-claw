## platform/esp32c3/components/rt_claw/Kconfig
```kconfig
menu "rt-claw Configuration"

    # AI Engine credentials and tuning are configured at the top level
    # via Meson options or environment variables.  See claw_config.h.

    menu "WiFi"

        config RTCLAW_WIFI_SSID
            string "Default WiFi SSID"
            default ""
            help
                Build-time WiFi SSID. Can be overridden at runtime
                via /wifi_set shell command (saved to NVS).

        config RTCLAW_WIFI_PASS
            string "Default WiFi password"
            default ""
            help
                Build-time WiFi password. Can be overridden at runtime
                via /wifi_set shell command (saved to NVS).

    endmenu

    menu "Module Selection"

        config RTCLAW_SHELL_ENABLE
            bool "Enable interactive UART shell"
            default y
            help
                Chat-first UART shell. Direct input goes to AI,
                /commands for system. Disable to save RAM when
                using only IM channels (e.g. Feishu).

        config RTCLAW_LCD_ENABLE
            bool "Enable LCD display"
            default n
            help
                QEMU RGB framebuffer or SPI LCD panel.
                Disable if no display hardware is present.

        config RTCLAW_SWARM_ENABLE
            bool "Enable swarm intelligence"
            default y
            help
                Node discovery, heartbeat, and distributed task
                scheduling over UDP broadcast.

        config RTCLAW_SCHED_ENABLE
            bool "Enable task scheduler"
            default y
            help
                Timer-driven task execution engine.

        config RTCLAW_SKILL_ENABLE
            bool "Enable skill system"
            default y
            help
                Predefined prompt templates (draw, monitor, greet).

        menu "Tool Use"

            config RTCLAW_TOOL_GPIO
                bool "GPIO tools"
                default y
                help
                    gpio_set, gpio_get, gpio_config tools.

            config RTCLAW_TOOL_SYSTEM
                bool "System info tools"
                default y
                help
                    system_info, memory_info, system_restart tools.

            config RTCLAW_TOOL_LCD
                bool "LCD drawing tools"
                default n
                depends on RTCLAW_LCD_ENABLE
                help
                    lcd_fill, lcd_text, lcd_rect, lcd_line, lcd_circle tools.

            config RTCLAW_TOOL_SCHED
                bool "Scheduler tools"
                default y
                depends on RTCLAW_SCHED_ENABLE
                help
                    schedule_task, remove_task tools.

            config RTCLAW_TOOL_NET
                bool "Network (HTTP) tools"
                default y
                help
                    http_request tool for GET/POST requests.

        endmenu

    endmenu

endmenu
```

## platform/esp32c3/sdkconfig.defaults.feishu
```kconfig
# rt-claw Feishu Bot — headless IM bot with full AI agent
#
# Usage:
#   cp sdkconfig.defaults.feishu sdkconfig.defaults
#   rm -f sdkconfig
#   idf.py set-target esp32c3
#   idf.py menuconfig   # set API key, Feishu App ID & Secret
#   idf.py build
#
# Enables: Feishu, tools (no LCD), skills, scheduler, swarm
# Disables: Shell (saves ~4KB RAM), LCD (headless mode)

# ---- Base platform ----
CONFIG_FREERTOS_HZ=1000
CONFIG_FREERTOS_TIMER_TASK_STACK_DEPTH=4096
CONFIG_ESP_SYSTEM_EVENT_TASK_STACK_SIZE=4096
CONFIG_ETH_ENABLED=y
CONFIG_ETH_USE_OPENETH=y
CONFIG_LWIP_DNS_SUPPORT_MDNS_QUERIES=n
CONFIG_ESP_CONSOLE_UART_DEFAULT=y
CONFIG_ESP_CONSOLE_UART_BAUDRATE=115200
CONFIG_ESPTOOLPY_FLASHSIZE_4MB=y
CONFIG_ESPTOOLPY_FLASHSIZE="4MB"
CONFIG_PARTITION_TABLE_CUSTOM=y
CONFIG_PARTITION_TABLE_CUSTOM_FILENAME="partitions.csv"
CONFIG_MBEDTLS_CERTIFICATE_BUNDLE=y
CONFIG_MBEDTLS_CERTIFICATE_BUNDLE_DEFAULT_FULL=y
CONFIG_MBEDTLS_SSL_PROTO_TLS1_3=y
CONFIG_ESP_MAIN_TASK_STACK_SIZE=16384
CONFIG_ESP32C3_REV_MIN_0=y
CONFIG_COMPILER_OPTIMIZATION_SIZE=y
CONFIG_NEWLIB_STDIN_LINE_ENDING_LF=y

# ---- rt-claw modules ----
# CONFIG_CLAW_SHELL_ENABLE is not set
# CONFIG_CLAW_LCD_ENABLE is not set
CONFIG_CLAW_SWARM_ENABLE=y
CONFIG_CLAW_SCHED_ENABLE=y
CONFIG_CLAW_SKILL_ENABLE=y
CONFIG_CLAW_TOOL_GPIO=y
CONFIG_CLAW_TOOL_SYSTEM=y
# CONFIG_CLAW_TOOL_LCD is not set
CONFIG_CLAW_TOOL_SCHED=y
CONFIG_CLAW_TOOL_NET=y

# ---- Feishu IM ----
CONFIG_CLAW_FEISHU_ENABLE=y
# Set App ID and Secret via: idf.py menuconfig -> rt-claw -> Feishu
```

## platform/esp32s3-qemu/components/rt_claw/Kconfig
```kconfig
menu "rt-claw Configuration"

    menu "AI Engine"

        config RTCLAW_AI_API_KEY
            string "LLM API Key"
            default ""
            help
                API key for LLM service (e.g. Claude, DeepSeek).
                Set via: idf.py menuconfig -> rt-claw -> AI Engine

        config RTCLAW_AI_API_URL
            string "LLM API endpoint URL"
            default "https://api.anthropic.com/v1/messages"
            help
                Full URL of the chat completion API endpoint.

        config RTCLAW_AI_MODEL
            string "LLM model name"
            default "claude-sonnet-4-6"
            help
                Model identifier sent in the API request.

        config RTCLAW_AI_MAX_TOKENS
            int "Max response tokens"
            default 1024
            range 64 4096

        config RTCLAW_AI_CONTEXT_SIZE
            int "AI response buffer size (bytes)"
            default 8192
            range 4096 65536
            help
                Size of the HTTP response buffer for AI API calls.
                Larger values allow longer AI responses but use more RAM.

        config RTCLAW_AI_MEMORY_MAX_MSGS
            int "Max conversation memory messages"
            default 20
            range 4 64
            help
                Maximum number of messages stored in AI conversation memory.
                When full, the oldest user+assistant pair is dropped.

    endmenu

    menu "Module Selection"

        config RTCLAW_SHELL_ENABLE
            bool "Enable interactive UART shell"
            default n
            help
                Chat-first UART shell. Direct input goes to AI,
                /commands for system. Disable to save RAM when
                using only IM channels (e.g. Feishu).

        config RTCLAW_LCD_ENABLE
            bool "Enable LCD display"
            default y
            help
                QEMU RGB framebuffer or SPI LCD panel.
                Disable if no display hardware is present.

        config RTCLAW_SWARM_ENABLE
            bool "Enable swarm intelligence"
            default y
            help
                Node discovery, heartbeat, and distributed task
                scheduling over UDP broadcast.

        config RTCLAW_SCHED_ENABLE
            bool "Enable task scheduler"
            default y
            help
                Timer-driven task execution engine.

        config RTCLAW_SKILL_ENABLE
            bool "Enable skill system"
            default y
            help
                Predefined prompt templates (draw, monitor, greet).

        menu "Tool Use"

            config RTCLAW_TOOL_GPIO
                bool "GPIO tools"
                default y
                help
                    gpio_set, gpio_get, gpio_config tools.

            config RTCLAW_TOOL_SYSTEM
                bool "System info tools"
                default y
                help
                    system_info, memory_info, system_restart tools.

            config RTCLAW_TOOL_LCD
                bool "LCD drawing tools"
                default y
                depends on RTCLAW_LCD_ENABLE
                help
                    lcd_fill, lcd_text, lcd_rect, lcd_line, lcd_circle tools.

            config RTCLAW_TOOL_SCHED
                bool "Scheduler tools"
                default y
                depends on RTCLAW_SCHED_ENABLE
                help
                    schedule_task, remove_task tools.

            config RTCLAW_TOOL_NET
                bool "Network (HTTP) tools"
                default y
                help
                    http_request tool for GET/POST requests.

        endmenu

    endmenu

    menu "Feishu (Lark) Integration"

        config RTCLAW_FEISHU_ENABLE
            bool "Enable Feishu IM integration"
            default n
            help
                Connect to Feishu via WebSocket long connection.
                Receives user messages and replies through AI engine.

        config RTCLAW_FEISHU_APP_ID
            string "Feishu App ID"
            default ""
            depends on RTCLAW_FEISHU_ENABLE
            help
                App ID from Feishu Open Platform (open.feishu.cn).

        config RTCLAW_FEISHU_APP_SECRET
            string "Feishu App Secret"
            default ""
            depends on RTCLAW_FEISHU_ENABLE
            help
                App Secret from Feishu Open Platform.

    endmenu

endmenu
```

## platform/esp32s3/boards/default/sdkconfig.defaults
```kconfig
# rt-claw ESP32-S3 real hardware — WiFi + PSRAM

# ---- Target: ESP32-S3 ----
CONFIG_IDF_TARGET="esp32s3"

# ---- Flash: 16MB QIO ----
CONFIG_ESPTOOLPY_FLASHSIZE_16MB=y
CONFIG_ESPTOOLPY_FLASHMODE_QIO=y

# ---- CPU: 240MHz ----
CONFIG_ESP_DEFAULT_CPU_FREQ_MHZ_240=y

# ---- PSRAM: 8MB Octal ----
CONFIG_SPIRAM=y
CONFIG_SPIRAM_MODE_OCT=y
CONFIG_SPIRAM_SPEED_80M=y
CONFIG_SPIRAM_MALLOC_ALWAYSINTERNAL=2048
CONFIG_SPIRAM_MALLOC_RESERVE_INTERNAL=98304
CONFIG_SPIRAM_MEMTEST=n

# ---- Ethernet: disabled (WiFi only) ----
# CONFIG_ETH_USE_SPI_ETHERNET is not set

# ---- WiFi ----
CONFIG_ESP_WIFI_STATIC_RX_BUFFER_NUM=3
CONFIG_ESP_WIFI_DYNAMIC_RX_BUFFER_NUM=6
CONFIG_ESP_WIFI_RX_BA_WIN=3
CONFIG_LWIP_TCPIP_RECVMBOX_SIZE=16
CONFIG_LWIP_LOCAL_HOSTNAME="rt-claw"

# ---- TLS: PSRAM allocation + reduced buffers ----
CONFIG_MBEDTLS_EXTERNAL_MEM_ALLOC=y
CONFIG_MBEDTLS_DYNAMIC_FREE_CONFIG_DATA=y
CONFIG_MBEDTLS_SSL_IN_CONTENT_LEN=16384
CONFIG_MBEDTLS_SSL_OUT_CONTENT_LEN=4096
CONFIG_MBEDTLS_CERTIFICATE_BUNDLE=y
CONFIG_MBEDTLS_CERTIFICATE_BUNDLE_DEFAULT_FULL=y
CONFIG_MBEDTLS_SSL_PROTO_TLS1_3=y

# ---- Partition table ----
CONFIG_PARTITION_TABLE_CUSTOM=y
CONFIG_PARTITION_TABLE_CUSTOM_FILENAME="boards/default/partitions.csv"

# ---- Console: UART primary, USB Serial/JTAG secondary ----
CONFIG_ESP_CONSOLE_UART_DEFAULT=y
CONFIG_ESP_CONSOLE_SECONDARY_USB_SERIAL_JTAG=y
CONFIG_ESP_CONSOLE_UART_BAUDRATE=115200

# ---- FreeRTOS ----
CONFIG_FREERTOS_HZ=1000
CONFIG_FREERTOS_TIMER_TASK_STACK_DEPTH=4096
CONFIG_ESP_SYSTEM_EVENT_TASK_STACK_SIZE=4096
CONFIG_ESP_MAIN_TASK_STACK_SIZE=16384

# ---- Dual-core: app logic on Core 1, WiFi/TLS on Core 0 ----
CONFIG_ESP_MAIN_TASK_AFFINITY_CPU1=y

# ---- Compiler ----
CONFIG_COMPILER_OPTIMIZATION_SIZE=y
CONFIG_NEWLIB_STDIN_LINE_ENDING_LF=y

# ---- rt-claw modules ----
CONFIG_RTCLAW_SHELL_ENABLE=y
CONFIG_RTCLAW_SWARM_ENABLE=y
CONFIG_RTCLAW_SCHED_ENABLE=y
CONFIG_RTCLAW_SKILL_ENABLE=y
CONFIG_RTCLAW_TOOL_GPIO=y
CONFIG_RTCLAW_TOOL_SYSTEM=y
CONFIG_RTCLAW_TOOL_SCHED=y
CONFIG_RTCLAW_TOOL_NET=y

# ---- IM integrations ----
# CONFIG_RTCLAW_FEISHU_ENABLE is not set
# CONFIG_RTCLAW_TELEGRAM_ENABLE is not set

# ---- OTA ----
CONFIG_RTCLAW_OTA_ENABLE=y
CONFIG_BOOTLOADER_APP_ROLLBACK_ENABLE=y

# AI Engine credentials and tuning: see claw_config.h + meson options
```

## platform/esp32s3/boards/qemu/sdkconfig.defaults
```kconfig
# rt-claw ESP32-S3 QEMU — full demo + API + Feishu

# ---- Base platform ----
CONFIG_FREERTOS_HZ=1000
CONFIG_FREERTOS_TIMER_TASK_STACK_DEPTH=4096
CONFIG_ESP_SYSTEM_EVENT_TASK_STACK_SIZE=4096
CONFIG_ETH_ENABLED=y
CONFIG_ETH_USE_OPENETH=y
CONFIG_LWIP_DNS_SUPPORT_MDNS_QUERIES=n
CONFIG_ESP_CONSOLE_UART_DEFAULT=y
CONFIG_ESP_CONSOLE_UART_BAUDRATE=115200
CONFIG_ESPTOOLPY_FLASHSIZE_4MB=y
CONFIG_ESPTOOLPY_FLASHSIZE="4MB"
CONFIG_PARTITION_TABLE_CUSTOM=y
CONFIG_PARTITION_TABLE_CUSTOM_FILENAME="boards/qemu/partitions.csv"
CONFIG_MBEDTLS_CERTIFICATE_BUNDLE=y
CONFIG_MBEDTLS_CERTIFICATE_BUNDLE_DEFAULT_FULL=y
CONFIG_MBEDTLS_SSL_PROTO_TLS1_3=y
CONFIG_ESP_MAIN_TASK_STACK_SIZE=16384
CONFIG_ESP32S3_REV_MIN_0=y
CONFIG_COMPILER_OPTIMIZATION_SIZE=y
CONFIG_NEWLIB_STDIN_LINE_ENDING_LF=y

# ---- rt-claw modules ----
CONFIG_RTCLAW_SHELL_ENABLE=y
CONFIG_RTCLAW_LCD_ENABLE=y
CONFIG_RTCLAW_SWARM_ENABLE=y
CONFIG_RTCLAW_SCHED_ENABLE=y
CONFIG_RTCLAW_SKILL_ENABLE=y
CONFIG_RTCLAW_TOOL_GPIO=y
CONFIG_RTCLAW_TOOL_SYSTEM=y
CONFIG_RTCLAW_TOOL_LCD=y
CONFIG_RTCLAW_TOOL_SCHED=y
CONFIG_RTCLAW_TOOL_NET=y

# ---- QEMU workaround: disable HW SHA (QEMU ESP32-S3 SHA DMA bug) ----
# CONFIG_MBEDTLS_HARDWARE_SHA is not set

# ---- Feishu (Lark) ----
# CONFIG_RTCLAW_FEISHU_ENABLE=y
```
