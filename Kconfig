## platform/esp32s3/components/rt_claw/Kconfig
```kconfig
menu "rt-claw Configuration"

    # AI Engine credentials and tuning are configured at the top level
    # via Meson options or environment variables.  See claw_config.h.

    menu "WiFi"

        config RTCLAW_WIFI_SSID
            string "Default WiFi SSID"
            default ""
            help
                Build-time WiFi SSID. Can be overridden at runtime
                via /wifi_set shell command (saved to NVS).

        config RTCLAW_WIFI_PASS
            string "Default WiFi password"
            default ""
            help
                Build-time WiFi password. Can be overridden at runtime
                via /wifi_set shell command (saved to NVS).

    endmenu

    menu "Module Selection"

        config RTCLAW_AI_BOOT_TEST
            bool "Run AI connection test at boot"
            default y
            help
                Send a test message to the LLM API during startup
                to verify connectivity.  Disable on real hardware
                to save time and bandwidth.

        config RTCLAW_SHELL_ENABLE
            bool "Enable interactive UART shell"
            default y
            help
                Chat-first UART shell. Direct input goes to AI,
                /commands for system. Disable to save RAM when
                using only IM channels (e.g. Feishu).

        config RTCLAW_LCD_ENABLE
            bool "Enable LCD display"
            default n
            help
                SPI LCD panel support.
                Disable if no display hardware is present.

        config RTCLAW_SWARM_ENABLE
            bool "Enable swarm intelligence"
            default y
            help
                Node discovery, heartbeat, and distributed task
                scheduling over UDP broadcast.

        config RTCLAW_SCHED_ENABLE
            bool "Enable task scheduler"
            default y
            help
                Timer-driven task execution engine.

        config RTCLAW_SKILL_ENABLE
            bool "Enable skill system"
            default y
            help
                Predefined prompt templates (draw, monitor, greet).

        config RTCLAW_FEISHU_ENABLE
            bool "Enable Feishu (Lark) IM integration"
            default n
            help
                WebSocket long connection to Feishu. Receives messages
                and replies via AI engine. No public IP needed.

        config RTCLAW_TELEGRAM_ENABLE
            bool "Enable Telegram Bot integration"
            default n
            help
                HTTP long-polling Telegram Bot. Receives messages and
                replies via AI engine. No public IP needed.

        config RTCLAW_HEARTBEAT_ENABLE
            bool "Enable periodic AI heartbeat"
            default n
            depends on RTCLAW_SCHED_ENABLE
            help
                Periodic LLM health check with device status reporting.

        config RTCLAW_OTA_ENABLE
            bool "Enable OTA firmware update"
            default n
            help
                Over-the-air firmware update via HTTP(S).
                Requires OTA partition table (ota_0 + ota_1).

        menu "Tool Use"

            config RTCLAW_TOOL_GPIO
                bool "GPIO tools"
                default y
                help
                    gpio_set, gpio_get, gpio_config tools.

            config RTCLAW_TOOL_SYSTEM
                bool "System info tools"
                default y
                help
                    system_info, memory_info, system_restart tools.

            config RTCLAW_TOOL_LCD
                bool "LCD drawing tools"
                default n
                depends on RTCLAW_LCD_ENABLE
                help
                    lcd_fill, lcd_text, lcd_rect, lcd_line, lcd_circle tools.

            config RTCLAW_TOOL_SCHED
                bool "Scheduler tools"
                default y
                depends on RTCLAW_SCHED_ENABLE
                help
                    schedule_task, remove_task tools.

            config RTCLAW_TOOL_NET
                bool "Network (HTTP) tools"
                default y
                help
                    http_request tool for GET/POST requests.

        endmenu

    endmenu

endmenu
```

## platform/esp32s3/sdkconfig.defaults
```kconfig
# rt-claw ESP32-S3 SDK configuration defaults

# FreeRTOS
CONFIG_FREERTOS_HZ=1000
CONFIG_FREERTOS_TIMER_TASK_STACK_DEPTH=4096

# System
CONFIG_ESP_SYSTEM_EVENT_TASK_STACK_SIZE=4096

# WiFi (enable later for real hardware)
# CONFIG_ESP_WIFI_ENABLED=y

# Ethernet — OpenCores MAC for QEMU
CONFIG_ETH_ENABLED=y
CONFIG_ETH_USE_OPENETH=y

# LWIP
CONFIG_LWIP_DNS_SUPPORT_MDNS_QUERIES=n

# Console / UART
CONFIG_ESP_CONSOLE_UART_DEFAULT=y
CONFIG_ESP_CONSOLE_UART_BAUDRATE=115200

# Flash
CONFIG_ESPTOOLPY_FLASHSIZE_4MB=y
CONFIG_ESPTOOLPY_FLASHSIZE="4MB"

# Partition table
CONFIG_PARTITION_TABLE_CUSTOM=y
CONFIG_PARTITION_TABLE_CUSTOM_FILENAME="partitions.csv"

# TLS / Certificate bundle (for HTTPS API calls)
CONFIG_MBEDTLS_CERTIFICATE_BUNDLE=y
CONFIG_MBEDTLS_CERTIFICATE_BUNDLE_DEFAULT_FULL=y
CONFIG_MBEDTLS_SSL_PROTO_TLS1_3=y

# Main task needs more stack for TLS + JSON parsing
CONFIG_ESP_MAIN_TASK_STACK_SIZE=16384

# QEMU chip revision (efuse reports v0.0)
CONFIG_ESP32S3_REV_MIN_0=y

# Optimization
CONFIG_COMPILER_OPTIMIZATION_SIZE=y

# Newlib
CONFIG_NEWLIB_STDIN_LINE_ENDING_LF=y

# Feishu (Lark) Integration
# CONFIG_CLAW_FEISHU_ENABLE=y
# Set App ID and Secret via: idf.py menuconfig -> rt-claw -> Feishu
```

## platform/zephyr/Kconfig
```kconfig
mainmenu "rt-claw Configuration"

config RTCLAW
	bool "rt-claw AI assistant"
	default y
	help
	  Enable the rt-claw embedded AI assistant framework.

source "Kconfig.zephyr"
```
